#define VERSION_MACRO
macro_ver: macro_ver {
compatible = "zmk,behavior-macro";
label = "macro_ver";
#binding-cells = <0>;
bindings = <&kp N2>, <&kp N0>, <&kp N2>, <&kp N4>, <&kp N1>, <&kp N1>, <&kp N1>, <&kp N2>, <&kp MINUS>, <&kp MINUS>, <&kp N5>, <&kp N5>, <&kp N0>, <&kp N9>, <&kp RET>;
};
